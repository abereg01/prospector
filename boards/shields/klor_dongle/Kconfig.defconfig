## boards/shields/klor_dongle/Kconfig.defconfig
```kconfig
if SHIELD_KLOR_DONGLE

config ZMK_KEYBOARD_NAME
    default "Prospector"

config ZMK_SPLIT
    default y

config ZMK_SPLIT_BLE_ROLE_CENTRAL
    default y

# Two peripherals: left half + right half
config ZMK_SPLIT_BLE_CENTRAL_PERIPHERALS
    default 2

endif # SHIELD_KLOR_DONGLE
```
